/*
 * SPDX-License-Identifier: MIT
 *
 * Copyright (C) 2013-2026 OpenMV, LLC.
 *
 * Permission is hereby granted, free of charge, to any person obtaining a copy
 * of this software and associated documentation files (the "Software"), to deal
 * in the Software without restriction, including without limitation the rights
 * to use, copy, modify, merge, publish, distribute, sublicense, and/or sell
 * copies of the Software, and to permit persons to whom the Software is
 * furnished to do so, subject to the following conditions:
 *
 * The above copyright notice and this permission notice shall be included in
 * all copies or substantial portions of the Software.
 *
 * THE SOFTWARE IS PROVIDED "AS IS", WITHOUT WARRANTY OF ANY KIND, EXPRESS OR
 * IMPLIED, INCLUDING BUT NOT LIMITED TO THE WARRANTIES OF MERCHANTABILITY,
 * FITNESS FOR A PARTICULAR PURPOSE AND NONINFRINGEMENT. IN NO EVENT SHALL THE
 * AUTHORS OR COPYRIGHT HOLDERS BE LIABLE FOR ANY CLAIM, DAMAGES OR OTHER
 * LIABILITY, WHETHER IN AN ACTION OF CONTRACT, TORT OR OTHERWISE, ARISING FROM,
 * OUT OF OR IN CONNECTION WITH THE SOFTWARE OR THE USE OR OTHER DEALINGS IN
 * THE SOFTWARE.
 *
 * image.Font: a TrueType font loaded from ROMFS (zero-copy) or the filesystem.
 */
#include <string.h>
#include "py/runtime.h"
#include "py/stream.h"
#include "extmod/vfs.h"

#include "imlib.h"
#include "umalloc.h"
#include "py_image.h"
#include "py_helper.h"

// The built-in font when ROMFS has no font list (see OMV_FONT_LIST_PATH).
#ifndef OMV_FONT_DEFAULT_PATH
#define OMV_FONT_DEFAULT_PATH       "/rom/RobotoMono-Regular.ttf"
#endif

// Pixel size of the built-in font, and of image.Font() when no size is given.
#ifndef OMV_FONT_DEFAULT_SIZE
#define OMV_FONT_DEFAULT_SIZE       (10.0f)
#endif

// Generated by mkromfs.py from the board's romfs_config.json: one ROMFS file name per
// line, the built-in font first and then the fonts it falls back to, in order.
#ifndef OMV_FONT_LIST_PATH
#define OMV_FONT_LIST_PATH          "/rom/fonts.txt"
#endif

// Largest font list read, in bytes.
#ifndef OMV_FONT_LIST_MAX
#define OMV_FONT_LIST_MAX           (256)
#endif

// Most fallback fonts chained behind the built-in font; further lines are ignored.
#ifndef OMV_FONT_FALLBACKS_MAX
#define OMV_FONT_FALLBACKS_MAX      (4)
#endif

#if defined(OMV_FONT_BUILTIN)
// Generated by tools/mkfont.py --c-array for boards without a ROMFS.
extern const uint8_t omv_font_builtin[];
extern const uint32_t omv_font_builtin_len;
#endif

typedef struct py_font_obj {
    mp_obj_base_t base;
    font_t font;        // The typeface at this object's size.
    mp_obj_t path;
    mp_obj_t fallback;  // Font object drawn for characters this one lacks (keeps it alive).
    // True when font.data is a persistent UMA copy of the file, which __del__ frees.
    // Otherwise it is ROMFS, or a block on the GC heap that font.data itself keeps alive
    // (so it must stay a pointer to the start of that block).
    bool uma_copy;
} py_font_obj_t;

extern const mp_obj_type_t py_font_type;

// The built-in font followed by its fallbacks (1 + OMV_FONT_FALLBACKS_MAX font_t), loaded
// on first use. It is on the heap behind a root pointer, so it costs nothing until text is
// drawn. A soft reset discards the heap but not the root pointer, so py_font_init0() clears
// it.
MP_REGISTER_ROOT_POINTER(void *omv_font_default);

void py_font_init0(void) {
    MP_STATE_VM(omv_font_default) = NULL;
}

// The message for each font error code (stored as compressed error text).
void py_font_check(font_err_t err) {
    mp_rom_error_text_t msg;
    switch (err) {
        case FONT_OK:
            return;
        case FONT_ERR_NOT_TRUETYPE:
            msg = MP_ERROR_TEXT("Not a TrueType font");
            break;
        case FONT_ERR_COLLECTION:
            msg = MP_ERROR_TEXT("TrueType collections are not supported");
            break;
        case FONT_ERR_CFF:
            msg = MP_ERROR_TEXT("CFF fonts are not supported");
            break;
        case FONT_ERR_TABLE_BOUNDS:
            msg = MP_ERROR_TEXT("Font table out of bounds");
            break;
        case FONT_ERR_TABLE_MISSING:
            msg = MP_ERROR_TEXT("Font is missing a required table");
            break;
        case FONT_ERR_UNITS:
            msg = MP_ERROR_TEXT("Invalid font units");
            break;
        case FONT_ERR_NO_GLYPHS:
            msg = MP_ERROR_TEXT("Font has no glyphs");
            break;
        case FONT_ERR_METRICS:
            msg = MP_ERROR_TEXT("Invalid font metrics");
            break;
        case FONT_ERR_NO_CMAP:
            msg = MP_ERROR_TEXT("Font has no usable Unicode cmap");
            break;
        case FONT_ERR_GLYPH:
            msg = MP_ERROR_TEXT("Corrupt glyph");
            break;
        default:
            msg = MP_ERROR_TEXT("Unknown font error");
            break;
    }
    mp_raise_msg(&mp_type_ValueError, msg);
}

static void py_font_load_file(py_font_obj_t *self, mp_obj_t path, float px, bool mapped_only) {
    #if MICROPY_VFS
    mp_obj_t file_args[2] = { path, MP_OBJ_NEW_QSTR(MP_QSTR_rb) };
    mp_obj_t file = mp_vfs_open(MP_ARRAY_SIZE(file_args), file_args, (mp_map_t *) &mp_const_empty_map);
    mp_buffer_info_t bufinfo;
    void *data;
    size_t size;
    self->uma_copy = false;

    if (mp_get_buffer(file, &bufinfo, MP_BUFFER_READ)) {
        // Memory-mapped (ROMFS): no copy.
        data = bufinfo.buf;
        size = bufinfo.len;
    } else if (mapped_only) {
        mp_stream_close(file);
        mp_raise_msg(&mp_type_OSError, MP_ERROR_TEXT("The default font must be in ROMFS"));
    } else {
        int error;
        mp_off_t res = mp_stream_seek(file, 0, MP_SEEK_END, &error);
        if (res == (mp_off_t) -1) {
            mp_raise_OSError(error);
        }
        if (mp_stream_seek(file, 0, MP_SEEK_SET, &error) == (mp_off_t) -1) {
            mp_raise_OSError(error);
        }
        size = res;
        // Prefer the GC heap, fall back to persistent UMA memory (freed by __del__).
        data = m_malloc_maybe(size);
        if (!data) {
            data = uma_malloc(size, UMA_PERSIST);
            self->uma_copy = true;
        }
        mp_stream_read_exactly(file, data, size, &error);
        if (error != 0) {
            if (self->uma_copy) {
                uma_free(data);
                self->uma_copy = false;
            }
            mp_raise_OSError(error);
        }
    }
    mp_stream_close(file);
    font_err_t err = font_load(&self->font, data, size, px);
    if (err != FONT_OK) {
        // Do not leave a half parsed font (or its persistent copy) behind.
        if (self->uma_copy) {
            uma_free(data);
            self->uma_copy = false;
        }
        self->font.data = NULL;
        py_font_check(err);
    }
    #else
    mp_raise_msg(&mp_type_RuntimeError, MP_ERROR_TEXT("File I/O is not supported"));
    #endif
}

#if !defined(OMV_FONT_BUILTIN)
// Reads /rom/fonts.txt into buf (NUL terminated). Returns false if there is no such file.
static bool py_font_read_list(char *buf, size_t size) {
    #if MICROPY_VFS
    nlr_buf_t nlr;
    if (nlr_push(&nlr) == 0) {
        mp_obj_t file_args[2] = { mp_obj_new_str_from_cstr(OMV_FONT_LIST_PATH), MP_OBJ_NEW_QSTR(MP_QSTR_rb) };
        mp_obj_t file = mp_vfs_open(MP_ARRAY_SIZE(file_args), file_args, (mp_map_t *) &mp_const_empty_map);
        int error;
        mp_uint_t len = mp_stream_rw(file, buf, size - 1, &error, MP_STREAM_RW_READ);
        mp_stream_close(file);
        nlr_pop();
        buf[len] = '\0';
        return len > 0;
    }
    #endif
    return false;
}

// The next file name in a font list (one per line, blank lines skipped) as a ROMFS path,
// or MP_OBJ_NULL at the end of the list. *list is moved past it.
static mp_obj_t py_font_list_next(const char **list) {
    for (const char *p = *list; *p;) {
        // The next line: [p, end), without its line ending.
        const char *end = p;
        while (*end && (*end != '\r') && (*end != '\n')) {
            end++;
        }
        const char *line = p;
        size_t len = end - p;
        p = *end ? (end + 1) : end;
        *list = p;
        if (len) {
            vstr_t path;
            vstr_init(&path, 5 + len);
            vstr_add_str(&path, "/rom/");
            vstr_add_strn(&path, line, len);
            return mp_obj_new_str_from_vstr(&path);
        }
    }
    return MP_OBJ_NULL;
}
#endif

// The file the default font is loaded from, or None when it is built into the firmware.
static mp_obj_t py_font_default_path(void) {
    #if defined(OMV_FONT_BUILTIN)
    return mp_const_none;
    #else
    char list[OMV_FONT_LIST_MAX];
    const char *p = list;
    mp_obj_t path = py_font_read_list(list, sizeof(list)) ? py_font_list_next(&p) : MP_OBJ_NULL;
    return (path != MP_OBJ_NULL) ? path : mp_obj_new_str_from_cstr(OMV_FONT_DEFAULT_PATH);
    #endif
}

const font_t *py_font_default(void) {
    font_t *fonts = MP_STATE_VM(omv_font_default);
    if (!fonts) {
        // fonts[0] is the built-in font, fonts[1..] the fonts it falls back to. Their data is
        // read straight out of flash.
        fonts = m_new0(font_t, 1 + OMV_FONT_FALLBACKS_MAX);
        #if defined(OMV_FONT_BUILTIN)
        py_font_check(font_load(&fonts[0], omv_font_builtin, omv_font_builtin_len, OMV_FONT_DEFAULT_SIZE));
        #else
        py_font_obj_t tmp;
        char list[OMV_FONT_LIST_MAX];
        if (!py_font_read_list(list, sizeof(list))) {
            // No font list in ROMFS: the compile time default, with no fallbacks.
            py_font_load_file(&tmp, mp_obj_new_str_from_cstr(OMV_FONT_DEFAULT_PATH), OMV_FONT_DEFAULT_SIZE, true);
            fonts[0] = tmp.font;
        } else {
            // One ROMFS file name per line: the default font, then its fallbacks in order.
            font_t *tail = NULL;
            size_t n = 0;
            const char *p = list;
            for (mp_obj_t path; (n <= OMV_FONT_FALLBACKS_MAX) && ((path = py_font_list_next(&p)) != MP_OBJ_NULL);) {
                py_font_load_file(&tmp, path, OMV_FONT_DEFAULT_SIZE, true);
                fonts[n] = tmp.font;
                if (tail) {
                    tail->fallback = &fonts[n];
                }
                tail = &fonts[n];
                n++;
            }
            if (!tail) {
                mp_raise_msg(&mp_type_OSError, MP_ERROR_TEXT("The default font must be in ROMFS"));
            }
        }
        #endif
        // Only once everything loaded, so that a failure is retried.
        MP_STATE_VM(omv_font_default) = fonts;
    }
    return fonts;
}

const font_t *py_font_from_obj(mp_obj_t obj) {
    if (obj == mp_const_none) {
        return py_font_default();
    }
    if (!mp_obj_is_type(obj, &py_font_type)) {
        mp_raise_msg(&mp_type_TypeError, MP_ERROR_TEXT("Expected a Font object"));
    }
    py_font_obj_t *self = MP_OBJ_TO_PTR(obj);
    return &self->font;
}

static mp_obj_t py_font_make_new(const mp_obj_type_t *type, size_t n_args, size_t n_kw, const mp_obj_t *all_args) {
    enum { ARG_path, ARG_size, ARG_fallback };
    static const mp_arg_t allowed_args[] = {
        { MP_QSTR_path,     MP_ARG_OBJ, {.u_rom_obj = MP_ROM_NONE} },
        { MP_QSTR_size,     MP_ARG_OBJ, {.u_rom_obj = MP_ROM_NONE} },
        { MP_QSTR_fallback, MP_ARG_OBJ | MP_ARG_KW_ONLY, {.u_rom_obj = MP_ROM_NONE} },
    };

    mp_arg_val_t args[MP_ARRAY_SIZE(allowed_args)];
    mp_arg_parse_all_kw_array(n_args, n_kw, all_args, MP_ARRAY_SIZE(allowed_args), allowed_args, args);

    py_font_obj_t *self = mp_obj_malloc_with_finaliser(py_font_obj_t, &py_font_type);
    self->uma_copy = false;
    self->fallback = mp_const_none;
    self->path = args[ARG_path].u_obj;
    float px = py_helper_arg_to_float(args[ARG_size].u_obj, OMV_FONT_DEFAULT_SIZE);
    if (!(px > 0.0f)) {
        mp_raise_msg(&mp_type_ValueError, MP_ERROR_TEXT("Font size must be > 0"));
    }

    bool is_default = self->path == mp_const_none;
    if (is_default) {
        // The default typeface (and its fallbacks) at this object's size.
        self->font = *py_font_default();
        self->font.px = px;
        self->path = py_font_default_path();
    } else {
        py_font_load_file(self, self->path, px, false);
    }
    // fallback: a Font, None for the default font and its chain, or False for no fallback.
    self->fallback = args[ARG_fallback].u_obj;
    if (self->fallback == mp_const_false) {
        self->font.fallback = NULL;
    } else if (self->fallback != mp_const_none) {
        if (!mp_obj_is_type(self->fallback, &py_font_type)) {
            mp_raise_msg(&mp_type_TypeError, MP_ERROR_TEXT("Expected a Font object"));
        }
        self->font.fallback = &((py_font_obj_t *) MP_OBJ_TO_PTR(self->fallback))->font;
    } else if (!is_default) {
        // Every font can draw at least what the default font (and its chain) can.
        self->font.fallback = py_font_default();
    }
    return MP_OBJ_FROM_PTR(self);
}

static mp_obj_t py_font_deinit(mp_obj_t self_in) {
    py_font_obj_t *self = MP_OBJ_TO_PTR(self_in);
    if (self->uma_copy) {
        uma_free((void *) self->font.data);
        self->font.data = NULL;
        self->uma_copy = false;
    }
    return mp_const_none;
}
static MP_DEFINE_CONST_FUN_OBJ_1(py_font_deinit_obj, py_font_deinit);

void py_font_layout(font_layout_t *layout, mp_obj_t scale, mp_int_t align, mp_int_t wrap_width, mp_int_t stroke_width) {
    layout->scale = py_helper_arg_to_float(scale, 1.0f);
    if (!(layout->scale > 0.0f)) {
        mp_raise_msg(&mp_type_ValueError, MP_ERROR_TEXT("Scale must be > 0"));
    }
    if ((align < FONT_ALIGN_LEFT) || (align > FONT_ALIGN_RIGHT)) {
        mp_raise_msg(&mp_type_ValueError, MP_ERROR_TEXT("Invalid alignment"));
    }
    if (wrap_width < 0) {
        mp_raise_msg(&mp_type_ValueError, MP_ERROR_TEXT("Wrap width must be >= 0"));
    }
    if ((stroke_width < 0) || (stroke_width > FONT_STROKE_MAX)) {
        mp_raise_msg(&mp_type_ValueError, MP_ERROR_TEXT("Stroke width ranges between 0 and 32"));
    }
    layout->align = align;
    layout->wrap_width = wrap_width;
    layout->stroke = stroke_width;
}

// The arguments of measure() and render(): text, then the first n_allowed of these keywords.
static void py_font_text_args(size_t n_args, const mp_obj_t *pos_args, mp_map_t *kw_args, size_t n_allowed,
                              const char **str, font_layout_t *layout) {
    enum { ARG_scale, ARG_align, ARG_wrap_width, ARG_stroke_width };
    static const mp_arg_t allowed_args[] = {
        { MP_QSTR_scale,        MP_ARG_OBJ | MP_ARG_KW_ONLY, {.u_rom_obj = MP_ROM_NONE} },
        { MP_QSTR_align,        MP_ARG_INT | MP_ARG_KW_ONLY, {.u_int = FONT_ALIGN_LEFT} },
        { MP_QSTR_wrap_width,   MP_ARG_INT | MP_ARG_KW_ONLY, {.u_int = 0} },
        { MP_QSTR_stroke_width, MP_ARG_INT | MP_ARG_KW_ONLY, {.u_int = 0} },
    };
    mp_arg_val_t args[MP_ARRAY_SIZE(allowed_args)] = {};
    mp_arg_parse_all(n_args - 2, pos_args + 2, kw_args, n_allowed, allowed_args, args);
    *str = mp_obj_str_get_str(pos_args[1]);
    py_font_layout(layout, args[ARG_scale].u_obj, args[ARG_align].u_int, args[ARG_wrap_width].u_int,
                   args[ARG_stroke_width].u_int);
}

// measure(text, scale=1.0, align=Font.LEFT, wrap_width=0, stroke_width=0) -> (w, h, baseline)
//
// w and h are the size of what draw_string() draws, and of the image render() returns, for
// the same arguments: the layout box (advance width of the widest line, line height times
// the number of lines, and the outline around them) grown to take in any ink that reaches
// outside it. baseline is the row of the first line's baseline in that box. Ink only
// reaches above the layout box for marks taller than the font's ascender, so baseline is
// normally the font's ascender plus the outline, which is also where draw_string() puts the
// baseline below the y it is given.
static mp_obj_t py_font_measure(size_t n_args, const mp_obj_t *pos_args, mp_map_t *kw_args) {
    py_font_obj_t *self = MP_OBJ_TO_PTR(pos_args[0]);
    const char *str;
    font_layout_t layout;
    py_font_text_args(n_args, pos_args, kw_args, 4, &str, &layout);

    font_box_t box;
    py_font_check(font_measure(&self->font, str, &layout, &box));
    mp_obj_t items[3] = {
        mp_obj_new_int(box.w), mp_obj_new_int(box.h), mp_obj_new_int(box.baseline - box.y)
    };
    return mp_obj_new_tuple(3, items);
}
static MP_DEFINE_CONST_FUN_OBJ_KW(py_font_measure_obj, 2, py_font_measure);

// render(text, scale=1.0, align=Font.LEFT, wrap_width=0) -> GRAYSCALE coverage image
static mp_obj_t py_font_render(size_t n_args, const mp_obj_t *pos_args, mp_map_t *kw_args) {
    py_font_obj_t *self = MP_OBJ_TO_PTR(pos_args[0]);
    const char *str;
    font_layout_t layout;
    py_font_text_args(n_args, pos_args, kw_args, 3, &str, &layout);

    font_box_t box;
    py_font_check(font_measure(&self->font, str, &layout, &box));
    // Text with no width (an empty string) still gets a one pixel wide, empty image.
    image_t img = { .w = IM_MAX(box.w, 1), .h = IM_MAX(box.h, 1), .pixfmt = PIXFORMAT_GRAYSCALE };
    image_alloc0(&img, image_size(&img));
    py_font_check(font_render(&self->font, str, &layout, &box, &img));
    return py_image_from_struct(&img);
}
static MP_DEFINE_CONST_FUN_OBJ_KW(py_font_render_obj, 2, py_font_render);

// has(text) -> True if every character of text has a glyph in this font or its fallbacks.
static mp_obj_t py_font_has(mp_obj_t self_in, mp_obj_t text) {
    py_font_obj_t *self = MP_OBJ_TO_PTR(self_in);
    return mp_obj_new_bool(font_has(&self->font, mp_obj_str_get_str(text)));
}
static MP_DEFINE_CONST_FUN_OBJ_2(py_font_has_obj, py_font_has);

static void py_font_attr(mp_obj_t self_in, qstr attr, mp_obj_t *dest) {
    py_font_obj_t *self = MP_OBJ_TO_PTR(self_in);
    if (dest[0] == MP_OBJ_NULL) {
        float s = self->font.px / self->font.units_per_em;
        switch (attr) {
            case MP_QSTR_path:
                dest[0] = self->path;
                break;
            case MP_QSTR_size:
                dest[0] = mp_obj_new_float(self->font.px);
                break;
            case MP_QSTR_fallback:
                dest[0] = self->fallback;
                break;
            case MP_QSTR_glyphs:
                dest[0] = mp_obj_new_int(self->font.num_glyphs);
                break;
            case MP_QSTR_bytes:
                dest[0] = mp_obj_new_int(self->font.size);
                break;
            case MP_QSTR_ascender:
                dest[0] = mp_obj_new_int(fast_roundf(self->font.ascender * s));
                break;
            case MP_QSTR_descender:
                dest[0] = mp_obj_new_int(fast_roundf(self->font.descender * s));
                break;
            case MP_QSTR_line_height:
                dest[0] = mp_obj_new_int(fast_roundf(font_line_height(&self->font)));
                break;
            default:
                // Continue lookup in locals_dict.
                dest[1] = MP_OBJ_SENTINEL;
                break;
        }
    }
}

// Prints every attribute, in the order they are documented.
static void py_font_print(const mp_print_t *print, mp_obj_t self_in, mp_print_kind_t kind) {
    static const qstr attrs[] = {
        MP_QSTR_path, MP_QSTR_size, MP_QSTR_fallback, MP_QSTR_glyphs, MP_QSTR_bytes,
        MP_QSTR_ascender, MP_QSTR_descender, MP_QSTR_line_height
    };
    for (size_t i = 0; i < MP_ARRAY_SIZE(attrs); i++) {
        mp_obj_t dest[2] = { MP_OBJ_NULL, MP_OBJ_NULL };
        py_font_attr(self_in, attrs[i], dest);
        if ((attrs[i] == MP_QSTR_fallback) && mp_obj_is_type(dest[0], &py_font_type)) {
            // Another font: show which, not all of it.
            dest[0] = ((py_font_obj_t *) MP_OBJ_TO_PTR(dest[0]))->path;
        }
        mp_printf(print, "%s\"%q\":", i ? ", " : "{", attrs[i]);
        mp_obj_print_helper(print, dest[0], PRINT_REPR);
    }
    mp_printf(print, "}");
}

static const mp_rom_map_elem_t py_font_locals_dict_table[] = {
    { MP_ROM_QSTR(MP_QSTR___del__),     MP_ROM_PTR(&py_font_deinit_obj) },
    { MP_ROM_QSTR(MP_QSTR_measure),     MP_ROM_PTR(&py_font_measure_obj) },
    { MP_ROM_QSTR(MP_QSTR_render),      MP_ROM_PTR(&py_font_render_obj) },
    { MP_ROM_QSTR(MP_QSTR_has),         MP_ROM_PTR(&py_font_has_obj) },
    { MP_ROM_QSTR(MP_QSTR_LEFT),        MP_ROM_INT(FONT_ALIGN_LEFT) },
    { MP_ROM_QSTR(MP_QSTR_CENTER),      MP_ROM_INT(FONT_ALIGN_CENTER) },
    { MP_ROM_QSTR(MP_QSTR_RIGHT),       MP_ROM_INT(FONT_ALIGN_RIGHT) },
};
static MP_DEFINE_CONST_DICT(py_font_locals_dict, py_font_locals_dict_table);

MP_DEFINE_CONST_OBJ_TYPE(
    py_font_type,
    MP_QSTR_Font,
    MP_TYPE_FLAG_NONE,
    attr, py_font_attr,
    print, py_font_print,
    make_new, py_font_make_new,
    locals_dict, &py_font_locals_dict
    );
